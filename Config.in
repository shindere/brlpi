## Config.in
```kconfig
source "$BR2_EXTERNAL_BRLPI_PATH/package/brltty/Config.in"
source "$BR2_EXTERNAL_BRLPI_PATH/package/bluepairy/Config.in"
source "$BR2_EXTERNAL_BRLPI_PATH/package/console-setup/Config.in"
source "$BR2_EXTERNAL_BRLPI_PATH/package/linux-brl-console/Config.in"
source "$BR2_EXTERNAL_BRLPI_PATH/package/llvm/Config.in"
source "$BR2_EXTERNAL_BRLPI_PATH/package/lynx/Config.in"
```

## configs/brlpi0w_defconfig
```kconfig
BR2_arm=y
BR2_arm1176jzf_s=y
BR2_ARM_EABIHF=y

# Linux headers same as kernel, a 4.9 series
BR2_PACKAGE_HOST_LINUX_HEADERS_CUSTOM_4_9=y

BR2_TOOLCHAIN_BUILDROOT_CXX=y

BR2_LINUX_KERNEL=y
BR2_LINUX_KERNEL_CUSTOM_GIT=y
BR2_LINUX_KERNEL_CUSTOM_REPO_URL="https://github.com/raspberrypi/linux.git"
BR2_LINUX_KERNEL_CUSTOM_REPO_VERSION="46cd72d4d8879b2ac9ae634fd891defa1f1fa83f"
BR2_LINUX_KERNEL_DEFCONFIG="bcmrpi"

# Build the DTBs for A/B from the kernel sources: the zero is the same
# as the A+ model, just in a different form-factor
BR2_LINUX_KERNEL_DTS_SUPPORT=y
BR2_LINUX_KERNEL_INTREE_DTS_NAME="bcm2708-rpi-b-plus bcm2708-rpi-0-w"

BR2_PACKAGE_RPI_FIRMWARE=y
# BR2_PACKAGE_RPI_FIRMWARE_INSTALL_DTB_OVERLAYS is not set

# Required tools to create the SD image
BR2_PACKAGE_HOST_DOSFSTOOLS=y
BR2_PACKAGE_HOST_GENIMAGE=y
BR2_PACKAGE_HOST_MTOOLS=y

# Filesystem / image
BR2_TARGET_ROOTFS_EXT2=y
BR2_TARGET_ROOTFS_EXT2_4=y
# BR2_TARGET_ROOTFS_TAR is not set
BR2_ROOTFS_POST_BUILD_SCRIPT="board/raspberrypi0/post-build.sh"
BR2_ROOTFS_POST_IMAGE_SCRIPT="board/raspberrypi0/post-image.sh"

BR2_ENABLE_LOCALE_PURGE=n
BR2_INIT_SYSTEMD=y
BR2_ROOTFS_POST_SCRIPT_ARGS="--add-pi3-miniuart-bt-overlay"
BR2_SYSTEM_ENABLE_NLS=y
BR2_TARGET_GENERIC_GETTY_PORT="tty1"
BR2_TARGET_ROOTFS_EXT2_SIZE="196M"
BR2_TOOLCHAIN_BUILDROOT_GLIBC=y
BR2_TOOLCHAIN_BUILDROOT_WCHAR=y
BR2_PACKAGE_BLUEPAIRY=y
BR2_PACKAGE_BRLTTY=y
BR2_PACKAGE_ICU=y
BR2_PACKAGE_KBD=y
BR2_PACKAGE_NCURSES=y
BR2_PACKAGE_NCURSES_WCHAR=y
BR2_PACKAGE_RPI_BT_FIRMWARE=y
BR2_PACKAGE_RPI_WIFI_FIRMWARE=y

# Additional packages
BR2_PACKAGE_CIFS_UTILS=y
BR2_PACKAGE_LFTP=y
BR2_PACKAGE_LFTP_CMD_TORRENT=y
BR2_PACKAGE_LFTP_PROTO_HTTP=y
BR2_PACKAGE_LINKS=y
BR2_PACKAGE_OPENSSH=y
BR2_PACKAGE_TOR=y
BR2_PACKAGE_WPA_SUPPLICANT=y
BR2_PACKAGE_WPA_SUPPLICANT_EAP=y
```

## configs/brlpi3_defconfig
```kconfig
BR2_aarch64=y
BR2_cortex_a53=y
BR2_ARM_FPU_VFPV4=y

BR2_TOOLCHAIN_BUILDROOT_CXX=y

# Linux headers same as kernel, a 4.9 series
BR2_PACKAGE_HOST_LINUX_HEADERS_CUSTOM_4_9=y

BR2_LINUX_KERNEL=y
BR2_LINUX_KERNEL_CUSTOM_GIT=y
BR2_LINUX_KERNEL_CUSTOM_REPO_URL="https://github.com/raspberrypi/linux.git"
BR2_LINUX_KERNEL_CUSTOM_REPO_VERSION="240d0482ad9341f7d98b06705d0a55e298034121"
BR2_LINUX_KERNEL_DEFCONFIG="bcmrpi3"

# Build the DTB from the kernel sources
BR2_LINUX_KERNEL_DTS_SUPPORT=y
BR2_LINUX_KERNEL_INTREE_DTS_NAME="broadcom/bcm2710-rpi-3-b broadcom/bcm2837-rpi-3-b"

BR2_PACKAGE_RPI_FIRMWARE=y
# BR2_PACKAGE_RPI_FIRMWARE_INSTALL_DTB_OVERLAYS is not set

# Required tools to create the SD image
BR2_PACKAGE_HOST_DOSFSTOOLS=y
BR2_PACKAGE_HOST_GENIMAGE=y
BR2_PACKAGE_HOST_MTOOLS=y

# Filesystem / image
BR2_TARGET_ROOTFS_EXT2=y
BR2_TARGET_ROOTFS_EXT2_4=y
# BR2_TARGET_ROOTFS_TAR is not set
BR2_ROOTFS_POST_BUILD_SCRIPT="board/raspberrypi3-64/post-build.sh"
BR2_ROOTFS_POST_IMAGE_SCRIPT="board/raspberrypi3-64/post-image.sh"
BR2_ROOTFS_POST_SCRIPT_ARGS="--aarch64"

BR2_GENERATE_LOCALE="de_AT.UTF-8 de_CH.UTF-8 de_DE.UTF-8 en_GB.UTF-8 en_US.UTF-8 fr_CA.UTF-8 fr_CH.UTF-8 fr_FR.UTF-8"
BR2_ROOTFS_OVERLAY="$(BR2_EXTERNAL_BRLPI_PATH)/rootfs-overlay $(HOME)/.config/brlpi/overlay"
BR2_GLOBAL_PATCH_DIR="$(BR2_EXTERNAL_BRLPI_PATH)/patches"
BR2_ENABLE_LOCALE_PURGE=n
BR2_INIT_SYSTEMD=y
BR2_SYSTEM_BIN_SH_ZSH=y
BR2_SYSTEM_DHCP="wlan0"
BR2_SYSTEM_ENABLE_NLS=y
BR2_TARGET_GENERIC_GETTY_PORT="tty1"
BR2_TARGET_ROOTFS_EXT2_SIZE="288M"
BR2_TOOLCHAIN_BUILDROOT_GLIBC=y
BR2_TOOLCHAIN_BUILDROOT_WCHAR=y
BR2_PACKAGE_BLUEZ5_UTILS_CLIENT=y
BR2_PACKAGE_BLUEZ5_UTILS_DEPRECATED=y
BR2_PACKAGE_BLUEPAIRY=y
BR2_PACKAGE_BRLTTY=y
BR2_PACKAGE_ICU=y
BR2_PACKAGE_KBD=y
BR2_PACKAGE_LINUX_BRL_CONSOLE=y
BR2_PACKAGE_NCURSES=y
BR2_PACKAGE_NCURSES_WCHAR=y
BR2_PACKAGE_RPI_BT_FIRMWARE=y
BR2_PACKAGE_RPI_WIFI_FIRMWARE=y
BR2_PACKAGE_SYSTEMD_FIRSTBOOT=y
BR2_PACKAGE_SYSTEMD_LOCALED=y
BR2_PACKAGE_SYSTEMD_LOGIND=y
BR2_PACKAGE_SYSTEMD_VCONSOLE=y

# Additional packages
BR2_PACKAGE_CA_CERTIFICATES=y
BR2_PACKAGE_CIFS_UTILS=y
BR2_PACKAGE_IPROUTE2=y
BR2_PACKAGE_LESS=y
BR2_PACKAGE_LFTP=y
BR2_PACKAGE_LFTP_CMD_TORRENT=y
BR2_PACKAGE_LFTP_PROTO_HTTP=y
BR2_PACKAGE_LIBIDN=y
BR2_PACKAGE_LYNX=y
BR2_PACKAGE_OPENSSH=y
BR2_PACKAGE_SCREEN=y
BR2_PACKAGE_TOR=y
BR2_PACKAGE_WGET=y
BR2_PACKAGE_WPA_SUPPLICANT=y
BR2_PACKAGE_WPA_SUPPLICANT_EAP=y
```

## package/bluepairy/Config.in
```kconfig
config BR2_PACKAGE_BLUEPAIRY
	bool "bluepairy"
	depends on BR2_TOOLCHAIN_BUILDROOT_CXX
	depends on BR2_TOOLCHAIN_HAS_THREADS
	select BR2_PACKAGE_BOOST
	select BR2_PACKAGE_BOOST_PROGRAM_OPTIONS
	select BR2_PACKAGE_BLUEZ5_UTILS
	help
	  Automatically pair bluetooth braille devices.

	  https://github.com/mlang/bluepairy/

comment "bluepairy needs a toolchain w/ cxx, threads"
	depends on !BR2_TOOLCHAIN_HAS_THREADS || !BR2_TOOLCHAIN_BUILDROOT_CXX
```

## package/brltty/Config.in
```kconfig
config BR2_PACKAGE_BRLTTY
	bool "brltty"
	depends on BR2_USE_WCHAR
	depends on BR2_TOOLCHAIN_HAS_THREADS
	select BR2_PACKAGE_BASH if BR2_INIT_SYSTEMD
	help
	  A daemon providing access to the Linux console
	  for a blind person using a refreshable braille display.

	  http://brltty.com/

comment "brltty needs a toolchain w/ threads, wchar"
	depends on !BR2_TOOLCHAIN_HAS_THREADS || !BR2_USE_WCHAR

if BR2_PACKAGE_BRLTTY

config BR2_PACKAGE_BRLTTY_TEXT_TABLE
	string "text-table"

endif
```

## package/console-setup/Config.in
```kconfig
config BR2_PACKAGE_CONSOLE_SETUP
	bool "console-setup"
	help
	  Console fonts from the Debian console-setup package.
```

## package/linux-brl-console/Config.in
```kconfig
config BR2_PACKAGE_LINUX_BRL_CONSOLE
	bool "linux-brl-console"
	help
	  Provides console fonts for the Unicode Braille row.
```

## package/lynx/Config.in
```kconfig
config BR2_PACKAGE_LYNX
	bool "lynx"
	select BR2_PACKAGE_NCURSES
	select BR2_PACKAGE_OPENSSL if !BR2_PACKAGE_GNUTLS
	help
	  Text mode web browser.
```
